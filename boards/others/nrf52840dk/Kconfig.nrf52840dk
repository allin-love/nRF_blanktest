## boards/others/nrf52840dk/board.yml
```yaml
board:
  extend: nrf52840dk
  variants:
    - name: ca03
      qualifier: nrf52840
```

## boards/others/nrf52840dk/nrf52840dk_nrf52840_ca03_defconfig
```kconfig
CONFIG_GPIO=y
CONFIG_FLASH_SIZE=1024
CONFIG_SRAM_SIZE=256
CONFIG_FLASH_BASE_ADDRESS=0x0
CONFIG_SRAM_BASE_ADDRESS=0x20000000

CONFIG_CLOCK_CONTROL=y
CONFIG_CLOCK_CONTROL_NRF=y
CONFIG_CLOCK_CONTROL_NRF_K32SRC_RC=y
CONFIG_CLOCK_CONTROL_NRF_K32SRC_500PPM=y
CONFIG_CLOCK_CONTROL_NRF_K32SRC_RC_CALIBRATION=y
```
